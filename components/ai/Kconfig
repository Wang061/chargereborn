## components/ai/Kconfig
```kconfig
menu "AI detector"
    choice AI_DETECTOR
        prompt "detector model"
        default AI_DETECTOR_ESPDET
        help
            Which on-board detector components/ai instantiates.
            espdet: M5 自训 ESPDet-Pico 单类 18650(默认, 板上已验证 219ms)。
            battery_yolo: 队友 YOLOv8n 4 类(21700/18650/9V/AA)。板上实测 5.8s/帧,
            每周期触发 5s task_wdt —— 架构级超载, 已否决, 仅留档勿选(见 CRASH_SIGNATURES 2026-07-04)。
            4 类能力由 ESPDet-Pico 重训接棒(feat/battery-espdet4)。

        config AI_DETECTOR_BATTERY_YOLO
            bool "battery_yolo (YOLOv8n 4-class)"

        config AI_DETECTOR_ESPDET
            bool "espdet (ESPDet-Pico single-class 18650)"
    endchoice
endmenu
```

## components/armlink/Kconfig
```kconfig
menu "armlink (机械臂通信桩)"

    config ARMLINK_UART_ENABLE
        bool "启用 UART 发送 (会驱动机械臂!)"
        default n
        help
            默认关。开启后 armlink 通过 UART 把目标指令发给 KM1 Steward，
            可能驱动舵机运动。启用前必须填 docs/ai/SAFETY.md 并分配 TX 引脚。

    config ARMLINK_UART_PORT_NUM
        int "UART 端口号"
        depends on ARMLINK_UART_ENABLE
        default 1
        help
            用 UART1，避开 UART0(主 console)。

    config ARMLINK_UART_TX_GPIO
        int "TX GPIO (-1=未分配, 拒绝初始化)"
        depends on ARMLINK_UART_ENABLE
        default -1
        help
            发送脚。默认 -1 强制显式分配；避开 35/36/37(PSRAM)、0/3/45/46(strapping)、19/20(USB-JTAG)。

    config ARMLINK_UART_RX_GPIO
        int "RX GPIO (-1=不接)"
        depends on ARMLINK_UART_ENABLE
        default -1
        help
            KM1 单向下发可不接 RX。

    config ARMLINK_UART_BAUD
        int "波特率"
        depends on ARMLINK_UART_ENABLE
        default 115200

    choice ARMLINK_PROTO
        prompt "发送协议"
        depends on ARMLINK_UART_ENABLE
        default ARMLINK_PROTO_KMS
        help
            KMS = $KMS:x,y,z,t! (Steward 自做 IK)；WRIST_SERVO = {#004P..T..!} (裸腕角)。
        config ARMLINK_PROTO_KMS
            bool "$KMS: 坐标(Steward IK)"
        config ARMLINK_PROTO_WRIST_SERVO
            bool "裸腕舵机角"
    endchoice

endmenu
```

## components/battery_detect/Kconfig
```kconfig
menu "models: battery_detect"
    config FLASH_ESPDET_PICO_224_224_BATTERY
        bool "flash espdet_pico_224_224_battery"
        depends on !CAT_DETECT_MODEL_IN_SDCARD
        default y


    choice
        prompt "default"
        default ESPDET_PICO_224_224_BATTERY
        help
            default battery_detect model
        config ESPDET_PICO_224_224_BATTERY
            bool "espdet_pico_224_224_battery"
            depends on ESPDET_DETECT_MODEL_IN_SDCARD || FLASH_ESPDET_PICO_224_224_BATTERY
    endchoice


    config DEFAULT_ESPDET_DETECT_MODEL
        int
        default 0 if ESPDET_PICO_224_224_BATTERY

    choice
        prompt "model location"
        default ESPDET_DETECT_MODEL_IN_FLASH_RODATA
        help
            espdet_detect model location
        config ESPDET_DETECT_MODEL_IN_FLASH_RODATA
            bool "flash_rodata"
        config ESPDET_DETECT_MODEL_IN_FLASH_PARTITION
            bool "flash_partition"
        config ESPDET_DETECT_MODEL_IN_SDCARD
            bool "sdcard"

    endchoice

    config ESPDET_DETECT_MODEL_LOCATION
        int
        default 0 if ESPDET_DETECT_MODEL_IN_FLASH_RODATA
        default 1 if ESPDET_DETECT_MODEL_IN_FLASH_PARTITION
        default 2 if ESPDET_DETECT_MODEL_IN_SDCARD

    config ESPDET_DETECT_MODEL_SDCARD_DIR
        string "espdet_detect model sdcard dir"
        default "models/s3" if IDF_TARGET_ESP32S3
        default "models/p4" if IDF_TARGET_ESP32P4
        depends on ESPDET_DETECT_MODEL_IN_SDCARD
        help
            Directory of models relative to sdcard mount point.
endmenu
```

## components/battery_detect4/Kconfig
```kconfig
menu "models: battery_detect4"
    config FLASH_ESPDET_PICO_224_224_BATTERY4
        bool "flash espdet_pico_224_224_battery4"
        depends on !ESPDET4_DETECT_MODEL_IN_SDCARD
        default y

    choice
        prompt "default"
        default ESPDET_PICO_224_224_BATTERY4
        help
            default battery_detect4 model
        config ESPDET_PICO_224_224_BATTERY4
            bool "espdet_pico_224_224_battery4"
            depends on ESPDET4_DETECT_MODEL_IN_SDCARD || FLASH_ESPDET_PICO_224_224_BATTERY4
    endchoice

    config DEFAULT_ESPDET4_DETECT_MODEL
        int
        # unconditional (sole enum member = 0): espdet4_detect.cpp always compiles
        # with the component, and .hpp uses this macro as a default arg - a
        # "default 0 if <model>" would drop the macro (and break the build)
        # whenever the FLASH flag is toggled off in an existing sdkconfig.
        default 0

    choice
        prompt "model location"
        default ESPDET4_DETECT_MODEL_IN_FLASH_RODATA
        help
            espdet4_detect model location
        config ESPDET4_DETECT_MODEL_IN_FLASH_RODATA
            bool "flash_rodata"
        config ESPDET4_DETECT_MODEL_IN_FLASH_PARTITION
            bool "flash_partition"
        config ESPDET4_DETECT_MODEL_IN_SDCARD
            bool "sdcard"
    endchoice

    config ESPDET4_DETECT_MODEL_LOCATION
        int
        default 0 if ESPDET4_DETECT_MODEL_IN_FLASH_RODATA
        default 1 if ESPDET4_DETECT_MODEL_IN_FLASH_PARTITION
        default 2 if ESPDET4_DETECT_MODEL_IN_SDCARD

    config ESPDET4_DETECT_MODEL_SDCARD_DIR
        string "espdet4_detect model sdcard dir"
        default "models/s3" if IDF_TARGET_ESP32S3
        default "models/p4" if IDF_TARGET_ESP32P4
        depends on ESPDET4_DETECT_MODEL_IN_SDCARD
        help
            Directory of models relative to sdcard mount point.
endmenu
```

## components/battery_yolo/Kconfig
```kconfig
menu "models: battery_yolo"
    config FLASH_BATTERY_YOLOV8N_224_S8
        bool "flash battery_yolov8n_224_s8"
        depends on !BATTERY_YOLO_MODEL_IN_SDCARD
        default y

    choice
        prompt "default"
        default BATTERY_YOLOV8N_224_S8
        help
            default battery_yolo model
        config BATTERY_YOLOV8N_224_S8
            bool "battery_yolov8n_224_s8"
            depends on BATTERY_YOLO_MODEL_IN_SDCARD || FLASH_BATTERY_YOLOV8N_224_S8
    endchoice

    config DEFAULT_BATTERY_YOLO_MODEL
        int
        default 0 if BATTERY_YOLOV8N_224_S8

    choice
        prompt "model location"
        default BATTERY_YOLO_MODEL_IN_FLASH_RODATA
        help
            battery_yolo model location
        config BATTERY_YOLO_MODEL_IN_FLASH_RODATA
            bool "flash_rodata"
        config BATTERY_YOLO_MODEL_IN_FLASH_PARTITION
            bool "flash_partition"
        config BATTERY_YOLO_MODEL_IN_SDCARD
            bool "sdcard"
    endchoice

    config BATTERY_YOLO_MODEL_LOCATION
        int
        default 0 if BATTERY_YOLO_MODEL_IN_FLASH_RODATA
        default 1 if BATTERY_YOLO_MODEL_IN_FLASH_PARTITION
        default 2 if BATTERY_YOLO_MODEL_IN_SDCARD

    config BATTERY_YOLO_MODEL_SDCARD_DIR
        string "battery_yolo model sdcard dir"
        default "models/s3" if IDF_TARGET_ESP32S3
        default "models/p4" if IDF_TARGET_ESP32P4
        depends on BATTERY_YOLO_MODEL_IN_SDCARD
        help
            Directory of models relative to sdcard mount point.
endmenu
```

## components/voicelink/Kconfig
```kconfig
menu "voicelink (语音开始/停止桩)"

    config VOICELINK_ENABLE
        bool "启用语音链路 UART 接收 (会直接触发连续抓取!)"
        default n
        help
            默认关。开启后 voicelink 监听 UART，收到 KM1 转发的 #Start!/#Stop!
            会调用 armctrl_request_run() 直接触发/停止连续抓取。启用前必须
            完成 docs/ai/SAFETY.md 确认并分配 RX 引脚。

    config VOICELINK_UART_PORT_NUM
        int "UART 端口号"
        depends on VOICELINK_ENABLE
        default 2
        help
            用 UART2，避开 UART0(主 console)、UART1(armlink 占用)。

    config VOICELINK_UART_RX_GPIO
        int "RX GPIO (-1=未分配, 拒绝初始化)"
        depends on VOICELINK_ENABLE
        default -1
        help
            接收脚。默认 -1 强制显式分配；避开 35/36/37(Octal PSRAM)、
            0/3/45/46(strapping)、19/20(USB-JTAG)、26-32(SPI flash)、
            43/44(UART0 console)、摄像头占用的 4-13/15-18/21、armlink 占用的 1。
            推荐 GPIO2（已核对 ESP32-S3 官方引脚表，P2 级无限制通用脚）。

    config VOICELINK_UART_BAUD
        int "波特率"
        depends on VOICELINK_ENABLE
        default 115200
        help
            须与语音模块自身 Serial1 配置、以及 KM1 Serial1.begin() 的
            115200 一致，否则乱码。

endmenu
```
